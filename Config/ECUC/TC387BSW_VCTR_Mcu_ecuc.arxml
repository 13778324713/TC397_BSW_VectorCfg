AUTOSAR XML (schema 00046)
package /Mcu
  module config Mcu: implementation-config-variant=VARIANT-POST-BUILD, module-description=Mcu_Impl
    CommonPublishedInformation:
      ArMajorVersion = 4
      ArMinorVersion = 2
      ArPatchVersion = 2
      ModuleId = 101
      Release = _TRICORE_TC387
      SwMajorVersion = 20
      SwMinorVersion = 0
      SwPatchVersion = 2
      VendorId = 17
    McuGeneralConfiguration:
      McuCcu60SleepModeEnabled = false
      McuCcu61SleepModeEnabled = false
      McuClearColdResetStatusApi = false
      McuClockSourceFailureNotification = false
      McuDevErrorDetect = false
      McuGetRamStateApi = false
      McuGpt12SleepModeEnabled = false
      McuGtmSleepModeEnabled = false
      McuIdleModeCpuCore = INDIVIDUAL_IDLE_CORES_SEL0
      McuIfxCpuCcuconApi = false
      McuIfxDeInitApi = false
      McuIfxLpmApi = false
      McuIfxTrapApi = false
      McuInitCheckApi = false
      McuInitClock = true
      McuInitDeInitApiMode = MCU_MCAL_SUPERVISOR
      McuMainOscillatorFrequency = 20
      McuMultiCoreErrorDetect = false
      McuNoPll = false
      McuOscAmpRegulationEnable = false
      McuOscCapacitance{0..3}Enable = false
      McuOscillatorMode = EXT_CRYSTAL_CERAMIC_RES_MODE_SEL0
      McuPerformResetApi = false
      McuRuntimeApiMode = MCU_MCAL_SUPERVISOR
      McuSafetyEnable = false
      McuStandbyEntryMode = STANDBY_ENTRY_REQ_SLEEP_SEL0
      McuSysClkFrequency = 20
      McuSystemModeCpuCore = CPU_SYSTEM_CORE0_SEL0
      McuVersionInfoApi = false
    McuHardwareResourceAllocationConf_0 (McuHardwareResourceAllocationConf)
      24 x McuAscLinAllocationConf:
        McuAscLinAllocationConf_0
          McuAscLinChannelAllocationConf: McuAscLinChannelAllocationConf=ASCLIN_CH_NOT_USED, McuAscLinKernelId=ASCLIN0
        McuAscLinAllocationConf_1
          McuAscLinChannelAllocationConf: McuAscLinChannelAllocationConf=ASCLIN_CH_NOT_USED, McuAscLinKernelId=ASCLIN0
        McuAscLinAllocationConf_10
          McuAscLinChannelAllocationConf: McuAscLinChannelAllocationConf=ASCLIN_CH_NOT_USED, McuAscLinKernelId=ASCLIN0
        McuAscLinAllocationConf_11
          McuAscLinChannelAllocationConf: McuAscLinChannelAllocationConf=ASCLIN_CH_NOT_USED, McuAscLinKernelId=ASCLIN0
        McuAscLinAllocationConf_12
          McuAscLinChannelAllocationConf: McuAscLinChannelAllocationConf=ASCLIN_CH_NOT_USED, McuAscLinKernelId=ASCLIN0
        McuAscLinAllocationConf_13
          McuAscLinChannelAllocationConf: McuAscLinChannelAllocationConf=ASCLIN_CH_NOT_USED, McuAscLinKernelId=ASCLIN0
        McuAscLinAllocationConf_14
          McuAscLinChannelAllocationConf: McuAscLinChannelAllocationConf=ASCLIN_CH_NOT_USED, McuAscLinKernelId=ASCLIN0
        McuAscLinAllocationConf_15
          McuAscLinChannelAllocationConf: McuAscLinChannelAllocationConf=ASCLIN_CH_NOT_USED, McuAscLinKernelId=ASCLIN0
        McuAscLinAllocationConf_16
          McuAscLinChannelAllocationConf: McuAscLinChannelAllocationConf=ASCLIN_CH_NOT_USED, McuAscLinKernelId=ASCLIN0
        McuAscLinAllocationConf_17
          McuAscLinChannelAllocationConf: McuAscLinChannelAllocationConf=ASCLIN_CH_NOT_USED, McuAscLinKernelId=ASCLIN0
        McuAscLinAllocationConf_18
          McuAscLinChannelAllocationConf: McuAscLinChannelAllocationConf=ASCLIN_CH_NOT_USED, McuAscLinKernelId=ASCLIN0
        McuAscLinAllocationConf_19
          McuAscLinChannelAllocationConf: McuAscLinChannelAllocationConf=ASCLIN_CH_NOT_USED, McuAscLinKernelId=ASCLIN0
        McuAscLinAllocationConf_2
          McuAscLinChannelAllocationConf: McuAscLinChannelAllocationConf=ASCLIN_CH_NOT_USED, McuAscLinKernelId=ASCLIN0
        McuAscLinAllocationConf_20
          McuAscLinChannelAllocationConf: McuAscLinChannelAllocationConf=ASCLIN_CH_NOT_USED, McuAscLinKernelId=ASCLIN0
        McuAscLinAllocationConf_21
          McuAscLinChannelAllocationConf: McuAscLinChannelAllocationConf=ASCLIN_CH_NOT_USED, McuAscLinKernelId=ASCLIN0
        McuAscLinAllocationConf_22
          McuAscLinChannelAllocationConf: McuAscLinChannelAllocationConf=ASCLIN_CH_NOT_USED, McuAscLinKernelId=ASCLIN0
        McuAscLinAllocationConf_23
          McuAscLinChannelAllocationConf: McuAscLinChannelAllocationConf=ASCLIN_CH_NOT_USED, McuAscLinKernelId=ASCLIN0
        McuAscLinAllocationConf_3
          McuAscLinChannelAllocationConf: McuAscLinChannelAllocationConf=ASCLIN_CH_NOT_USED, McuAscLinKernelId=ASCLIN0
        McuAscLinAllocationConf_4
          McuAscLinChannelAllocationConf: McuAscLinChannelAllocationConf=ASCLIN_CH_NOT_USED, McuAscLinKernelId=ASCLIN0
        McuAscLinAllocationConf_5
          McuAscLinChannelAllocationConf: McuAscLinChannelAllocationConf=ASCLIN_CH_NOT_USED, McuAscLinKernelId=ASCLIN0
        McuAscLinAllocationConf_6
          McuAscLinChannelAllocationConf: McuAscLinChannelAllocationConf=ASCLIN_CH_NOT_USED, McuAscLinKernelId=ASCLIN0
        McuAscLinAllocationConf_7
          McuAscLinChannelAllocationConf: McuAscLinChannelAllocationConf=ASCLIN_CH_NOT_USED, McuAscLinKernelId=ASCLIN0
        McuAscLinAllocationConf_8
          McuAscLinChannelAllocationConf: McuAscLinChannelAllocationConf=ASCLIN_CH_NOT_USED, McuAscLinKernelId=ASCLIN0
        McuAscLinAllocationConf_9
          McuAscLinChannelAllocationConf: McuAscLinChannelAllocationConf=ASCLIN_CH_NOT_USED, McuAscLinKernelId=ASCLIN0
      McuCcu6ModuleAllocationConf_0 (McuCcu6ModuleAllocationConf): McuCcu6ModuleAllocationConf=CCU6_MODULE_NOT_USED
      McuCcu6ModuleAllocationConf_1 (McuCcu6ModuleAllocationConf): McuCcu6ModuleAllocationConf=CCU6_MODULE_NOT_USED
      McuEruAllocationConf_0 (McuEruAllocationConf)
        8 x McuEruChannelInputLineConf, all with McuEruChannelInputLineConf=ERU_CHANNEL_INP_NOT_USED:
          McuEruChannelInputLineConf_{0..7}
        8 x McuEruChannelOutputUnitConf, all with McuEruChannelOutputUnitConf=ERU_CHANNEL_OUT_NOT_USED:
          McuEruChannelOutputUnitConf_{0..7}
      5 x McuGpt12ModuleAllocationConf:
        McuGpt12ModuleAllocationConf_0: McuGpt12ModuleAllocationConf=GPT_TIMER_USED_BY_GPT_DRIVER, McuGpt12TimerAllocation=GPT_TIMER_2
        McuGpt12ModuleAllocationConf_1: McuGpt12ModuleAllocationConf=GPT_TIMER_USED_BY_GPT_DRIVER, McuGpt12TimerAllocation=GPT_TIMER_3
        McuGpt12ModuleAllocationConf_2: McuGpt12ModuleAllocationConf=GPT_TIMER_NOT_USED, McuGpt12TimerAllocation=GPT_TIMER_4
        McuGpt12ModuleAllocationConf_3: McuGpt12ModuleAllocationConf=GPT_TIMER_NOT_USED, McuGpt12TimerAllocation=GPT_TIMER_5
        McuGpt12ModuleAllocationConf_4: McuGpt12ModuleAllocationConf=GPT_TIMER_NOT_USED, McuGpt12TimerAllocation=GPT_TIMER_6
      McuGtmAllocationConf_0 (McuGtmAllocationConf)
        9 x McuGtmAtomAllocationConf:
          McuGtmAtomAllocationConf_0
            8 x McuGtmAtomChannelAllocationConf, all with McuAtomChannelEventHandledByDsadc=false:
              McuGtmAtomChannelAllocationConf_0: McuGtmAtomChannelAllocationConf=GTM_ATOM_CHANNEL_USED_BY_GPT
              McuGtmAtomChannelAllocationConf_{1..7}: McuGtmAtomChannelAllocationConf=GTM_ATOM_CHANNEL_NOT_USED
          McuGtmAtomAllocationConf_1
            8 x McuGtmAtomChannelAllocationConf, all with McuAtomChannelEventHandledByDsadc=false, McuGtmAtomChannelAllocationConf=GTM_ATOM_CHANNEL_NOT_USED:
              McuGtmAtomChannelAllocationConf_{0..7}
          McuGtmAtomAllocationConf_2
            8 x McuGtmAtomChannelAllocationConf, all with McuAtomChannelEventHandledByDsadc=false, McuGtmAtomChannelAllocationConf=GTM_ATOM_CHANNEL_NOT_USED:
              McuGtmAtomChannelAllocationConf_{0..7}
          McuGtmAtomAllocationConf_3
            8 x McuGtmAtomChannelAllocationConf, all with McuAtomChannelEventHandledByDsadc=false:
              McuGtmAtomChannelAllocationConf_{0..5}: McuGtmAtomChannelAllocationConf=GTM_ATOM_CHANNEL_NOT_USED
              McuGtmAtomChannelAllocationConf_6: McuGtmAtomChannelAllocationConf=GTM_ATOM_CHANNEL_USED_BY_PWM
              McuGtmAtomChannelAllocationConf_7: McuGtmAtomChannelAllocationConf=GTM_ATOM_CHANNEL_NOT_USED
          McuGtmAtomAllocationConf_4
            8 x McuGtmAtomChannelAllocationConf, all with McuAtomChannelEventHandledByDsadc=false, McuGtmAtomChannelAllocationConf=GTM_ATOM_CHANNEL_NOT_USED:
              McuGtmAtomChannelAllocationConf_{0..7}
          McuGtmAtomAllocationConf_5
            8 x McuGtmAtomChannelAllocationConf, all with McuAtomChannelEventHandledByDsadc=false, McuGtmAtomChannelAllocationConf=GTM_ATOM_CHANNEL_NOT_USED:
              McuGtmAtomChannelAllocationConf_{0..7}
          McuGtmAtomAllocationConf_6
            8 x McuGtmAtomChannelAllocationConf, all with McuAtomChannelEventHandledByDsadc=false, McuGtmAtomChannelAllocationConf=GTM_ATOM_CHANNEL_NOT_USED:
              McuGtmAtomChannelAllocationConf_{0..7}
          McuGtmAtomAllocationConf_7
            8 x McuGtmAtomChannelAllocationConf, all with McuAtomChannelEventHandledByDsadc=false, McuGtmAtomChannelAllocationConf=GTM_ATOM_CHANNEL_NOT_USED:
              McuGtmAtomChannelAllocationConf_{0..7}
          McuGtmAtomAllocationConf_8
            8 x McuGtmAtomChannelAllocationConf, all with McuAtomChannelEventHandledByDsadc=false, McuGtmAtomChannelAllocationConf=GTM_ATOM_CHANNEL_NOT_USED:
              McuGtmAtomChannelAllocationConf_{0..7}
        7 x McuGtmTimAllocationConf:
          McuGtmTimAllocationConf_0
            8 x McuGtmTimChannelAllocationConf, all with McuGtmTimChannelAllocationConf=GTM_TIM_CHANNEL_NOT_USED:
              McuGtmTimChannelAllocationConf_{0..7}
          McuGtmTimAllocationConf_1
            8 x McuGtmTimChannelAllocationConf, all with McuGtmTimChannelAllocationConf=GTM_TIM_CHANNEL_NOT_USED:
              McuGtmTimChannelAllocationConf_{0..7}
          McuGtmTimAllocationConf_2
            8 x McuGtmTimChannelAllocationConf:
              McuGtmTimChannelAllocationConf_0: McuGtmTimChannelAllocationConf=GTM_TIM_CHANNEL_NOT_USED
              McuGtmTimChannelAllocationConf_1: McuGtmTimChannelAllocationConf=GTM_TIM_CHANNEL_NOT_USED
              McuGtmTimChannelAllocationConf_2: McuGtmTimChannelAllocationConf=GTM_TIM_CHANNEL_USED_BY_ICU
              McuGtmTimChannelAllocationConf_{3..7}: McuGtmTimChannelAllocationConf=GTM_TIM_CHANNEL_NOT_USED
          McuGtmTimAllocationConf_3
            8 x McuGtmTimChannelAllocationConf, all with McuGtmTimChannelAllocationConf=GTM_TIM_CHANNEL_NOT_USED:
              McuGtmTimChannelAllocationConf_{0..7}
          McuGtmTimAllocationConf_4
            8 x McuGtmTimChannelAllocationConf, all with McuGtmTimChannelAllocationConf=GTM_TIM_CHANNEL_NOT_USED:
              McuGtmTimChannelAllocationConf_{0..7}
          McuGtmTimAllocationConf_5
            8 x McuGtmTimChannelAllocationConf, all with McuGtmTimChannelAllocationConf=GTM_TIM_CHANNEL_NOT_USED:
              McuGtmTimChannelAllocationConf_{0..7}
          McuGtmTimAllocationConf_6
            8 x McuGtmTimChannelAllocationConf, all with McuGtmTimChannelAllocationConf=GTM_TIM_CHANNEL_NOT_USED:
              McuGtmTimChannelAllocationConf_{0..7}
        5 x McuGtmTomAllocationConf:
          McuGtmTomAllocationConf_0
            16 x McuGtmTomChannelAllocationConf, all with McuTomChannelEventHandledByDsadc=false:
              McuGtmTomChannelAllocationConf_0: McuGtmTomChannelAllocationConf=GTM_TOM_CHANNEL_NOT_USED
              McuGtmTomChannelAllocationConf_1: McuGtmTomChannelAllocationConf=GTM_TOM_CHANNEL_NOT_USED
              McuGtmTomChannelAllocationConf_{10..15}: McuGtmTomChannelAllocationConf=GTM_TOM_CHANNEL_NOT_USED
              McuGtmTomChannelAllocationConf_{2..5}: McuGtmTomChannelAllocationConf=GTM_TOM_CHANNEL_NOT_USED
              McuGtmTomChannelAllocationConf_6: McuGtmTomChannelAllocationConf=GTM_TOM_CHANNEL_USED_BY_ADC
              McuGtmTomChannelAllocationConf_7: McuGtmTomChannelAllocationConf=GTM_TOM_CHANNEL_NOT_USED
              McuGtmTomChannelAllocationConf_8: McuGtmTomChannelAllocationConf=GTM_TOM_CHANNEL_USED_BY_PWM
              McuGtmTomChannelAllocationConf_9: McuGtmTomChannelAllocationConf=GTM_TOM_CHANNEL_USED_BY_PWM
          McuGtmTomAllocationConf_1
            16 x McuGtmTomChannelAllocationConf, all with McuTomChannelEventHandledByDsadc=false:
              McuGtmTomChannelAllocationConf_0: McuGtmTomChannelAllocationConf=GTM_TOM_CHANNEL_USED_BY_GPT
              McuGtmTomChannelAllocationConf_1: McuGtmTomChannelAllocationConf=GTM_TOM_CHANNEL_NOT_USED
              McuGtmTomChannelAllocationConf_{10..15}: McuGtmTomChannelAllocationConf=GTM_TOM_CHANNEL_NOT_USED
              McuGtmTomChannelAllocationConf_{2..9}: McuGtmTomChannelAllocationConf=GTM_TOM_CHANNEL_NOT_USED
          McuGtmTomAllocationConf_2
            16 x McuGtmTomChannelAllocationConf, all with McuGtmTomChannelAllocationConf=GTM_TOM_CHANNEL_NOT_USED, McuTomChannelEventHandledByDsadc=false:
              McuGtmTomChannelAllocationConf_0
              McuGtmTomChannelAllocationConf_1
              McuGtmTomChannelAllocationConf_{10..15}
              McuGtmTomChannelAllocationConf_{2..9}
          McuGtmTomAllocationConf_3
            16 x McuGtmTomChannelAllocationConf, all with McuGtmTomChannelAllocationConf=GTM_TOM_CHANNEL_NOT_USED, McuTomChannelEventHandledByDsadc=false:
              McuGtmTomChannelAllocationConf_0
              McuGtmTomChannelAllocationConf_1
              McuGtmTomChannelAllocationConf_{10..15}
              McuGtmTomChannelAllocationConf_{2..9}
          McuGtmTomAllocationConf_4
            16 x McuGtmTomChannelAllocationConf, all with McuGtmTomChannelAllocationConf=GTM_TOM_CHANNEL_NOT_USED, McuTomChannelEventHandledByDsadc=false:
              McuGtmTomChannelAllocationConf_0
              McuGtmTomChannelAllocationConf_1
              McuGtmTomChannelAllocationConf_{10..15}
              McuGtmTomChannelAllocationConf_{2..9}
        McuGtmTimAllocationConf
          8 x McuGtmTimChannelAllocationConf, all with McuGtmTimChannelAllocationConf=GTM_TIM_CHANNEL_NOT_USED:
            McuGtmTimChannelAllocationConf
            McuGtmTimChannelAllocationConf_{1..7}
        McuGtmTomAllocationConf
          16 x McuGtmTomChannelAllocationConf, all with McuGtmTomChannelAllocationConf=GTM_TOM_CHANNEL_NOT_USED:
            McuGtmTomChannelAllocationConf
            McuGtmTomChannelAllocationConf_{1..15}
        3 x McuGtmAtomAllocationConf:
          McuGtmAtomAllocationConf
            8 x McuGtmAtomChannelAllocationConf, all with McuGtmAtomChannelAllocationConf=GTM_ATOM_CHANNEL_NOT_USED:
              McuGtmAtomChannelAllocationConf
              McuGtmAtomChannelAllocationConf_{1..7}
          McuGtmAtomAllocationConf_9
            8 x McuGtmAtomChannelAllocationConf, all with McuGtmAtomChannelAllocationConf=GTM_ATOM_CHANNEL_NOT_USED:
              McuGtmAtomChannelAllocationConf
              McuGtmAtomChannelAllocationConf_{1..7}
          McuGtmAtomAllocationConf_10
            8 x McuGtmAtomChannelAllocationConf, all with McuGtmAtomChannelAllocationConf=GTM_ATOM_CHANNEL_NOT_USED:
              McuGtmAtomChannelAllocationConf
              McuGtmAtomChannelAllocationConf_{1..7}
      6 x McuStmAllocationConf, all with McuStmCmp0RegAllocationConf=STM_CMP0_NOT_USED, McuStmCmp1RegAllocationConf=STM_CMP1_NOT_USED:
        McuStmAllocationConf_{0..3}
        McuStmAllocationConf
        McuStmAllocationConf_4
    McuModuleConfiguration: McuClockSrcFailureNotification=DISABLED, McuNumberOfMcuModes=1, McuRamSectors=0
      GtmGlobalConfiguration_0 (GtmGlobalConfiguration)
        9 x GtmAtomGlobalConf:
          GtmAtomGlobalConf_0
            8 x GtmAtomChannelConf, all with GtmAtomChInternalTriggerEnable=false, GtmAtomChResetCn0OnTriggerEnable=false, GtmTimerPortPinSelect=NONE:
              GtmAtomChannelConf_{0..7}
            GtmAtomGroupConf
              GtmAtomActionTimeBaseUnitConf: GtmAtomActionTimeBaseSelection=ATOM_ACT_TB_TBU_TS0, GtmAtomActionTimeBaseValue=1
          GtmAtomGlobalConf_1
            8 x GtmAtomChannelConf, all with GtmAtomChInternalTriggerEnable=false, GtmAtomChResetCn0OnTriggerEnable=false, GtmTimerPortPinSelect=NONE:
              GtmAtomChannelConf_{0..7}
            GtmAtomGroupConf
              GtmAtomActionTimeBaseUnitConf: GtmAtomActionTimeBaseSelection=ATOM_ACT_TB_TBU_TS0, GtmAtomActionTimeBaseValue=1
          GtmAtomGlobalConf_2
            8 x GtmAtomChannelConf, all with GtmAtomChInternalTriggerEnable=false, GtmAtomChResetCn0OnTriggerEnable=false, GtmTimerPortPinSelect=NONE:
              GtmAtomChannelConf_{0..7}
            GtmAtomGroupConf
              GtmAtomActionTimeBaseUnitConf: GtmAtomActionTimeBaseSelection=ATOM_ACT_TB_TBU_TS0, GtmAtomActionTimeBaseValue=1
          GtmAtomGlobalConf_3
            8 x GtmAtomChannelConf, all with GtmAtomChInternalTriggerEnable=false, GtmAtomChResetCn0OnTriggerEnable=false:
              GtmAtomChannelConf_{0..5}: GtmTimerPortPinSelect=NONE
              GtmAtomChannelConf_6: GtmTimerPortPinSelect=TOUT92_SELD_3_PORT13_PIN1
              GtmAtomChannelConf_7: GtmTimerPortPinSelect=NONE
            GtmAtomGroupConf
              GtmAtomActionTimeBaseUnitConf: GtmAtomActionTimeBaseSelection=ATOM_ACT_TB_TBU_TS0, GtmAtomActionTimeBaseValue=1
          GtmAtomGlobalConf_4
            8 x GtmAtomChannelConf, all with GtmAtomChInternalTriggerEnable=false, GtmAtomChResetCn0OnTriggerEnable=false, GtmTimerPortPinSelect=NONE:
              GtmAtomChannelConf_{0..7}
            GtmAtomGroupConf
              GtmAtomActionTimeBaseUnitConf: GtmAtomActionTimeBaseSelection=ATOM_ACT_TB_TBU_TS0, GtmAtomActionTimeBaseValue=1
          GtmAtomGlobalConf_5
            8 x GtmAtomChannelConf, all with GtmAtomChInternalTriggerEnable=false, GtmAtomChResetCn0OnTriggerEnable=false, GtmTimerPortPinSelect=NONE:
              GtmAtomChannelConf_{0..7}
            GtmAtomGroupConf
              GtmAtomActionTimeBaseUnitConf: GtmAtomActionTimeBaseSelection=ATOM_ACT_TB_TBU_TS0, GtmAtomActionTimeBaseValue=1
          GtmAtomGlobalConf_6
            8 x GtmAtomChannelConf, all with GtmAtomChInternalTriggerEnable=false, GtmAtomChResetCn0OnTriggerEnable=false, GtmTimerPortPinSelect=NONE:
              GtmAtomChannelConf_{0..7}
            GtmAtomGroupConf
              GtmAtomActionTimeBaseUnitConf: GtmAtomActionTimeBaseSelection=ATOM_ACT_TB_TBU_TS0, GtmAtomActionTimeBaseValue=1
          GtmAtomGlobalConf_7
            8 x GtmAtomChannelConf, all with GtmAtomChInternalTriggerEnable=false, GtmAtomChResetCn0OnTriggerEnable=false, GtmTimerPortPinSelect=NONE:
              GtmAtomChannelConf_{0..7}
            GtmAtomGroupConf
              GtmAtomActionTimeBaseUnitConf: GtmAtomActionTimeBaseSelection=ATOM_ACT_TB_TBU_TS0, GtmAtomActionTimeBaseValue=1
          GtmAtomGlobalConf_8
            8 x GtmAtomChannelConf, all with GtmAtomChInternalTriggerEnable=false, GtmAtomChResetCn0OnTriggerEnable=false, GtmTimerPortPinSelect=NONE:
              GtmAtomChannelConf_{0..7}
            GtmAtomGroupConf
              GtmAtomActionTimeBaseUnitConf: GtmAtomActionTimeBaseSelection=ATOM_ACT_TB_TBU_TS0, GtmAtomActionTimeBaseValue=1
        9 x GtmClusterConf, all with GtmCmuClusterInputClockDividerEnable=CLS_CLK_CFG_ENABLED_WITH_DIV_SEL2:
          GtmClusterConf_0
            GtmClusterConfClockSetting:
              GtmClusterConfClock{0..7}Src = CMU_CONF_CLOCK{0..7}_SEL0
            GtmClusterFixedClockSetting: GtmClusterFixedClockSrc=CMU_FIXED_CLOCK0_SEL0
          GtmClusterConf_1
            GtmClusterConfClockSetting:
              GtmClusterConfClock{0..7}Src = CMU_CONF_CLOCK{0..7}_SEL0
            GtmClusterFixedClockSetting: GtmClusterFixedClockSrc=CMU_FIXED_CLOCK0_SEL0
          GtmClusterConf_2
            GtmClusterConfClockSetting:
              GtmClusterConfClock{0..7}Src = CMU_CONF_CLOCK{0..7}_SEL0
            GtmClusterFixedClockSetting: GtmClusterFixedClockSrc=CMU_FIXED_CLOCK0_SEL0
          GtmClusterConf_3
            GtmClusterConfClockSetting:
              GtmClusterConfClock{0..7}Src = CMU_CONF_CLOCK{0..7}_SEL0
            GtmClusterFixedClockSetting: GtmClusterFixedClockSrc=CMU_FIXED_CLOCK0_SEL0
          GtmClusterConf_4
            GtmClusterConfClockSetting:
              GtmClusterConfClock{0..7}Src = CMU_CONF_CLOCK{0..7}_SEL0
            GtmClusterFixedClockSetting: GtmClusterFixedClockSrc=CMU_FIXED_CLOCK0_SEL0
          GtmClusterConf_5
            GtmClusterConfClockSetting:
              GtmClusterConfClock{0..7}Src = CMU_CONF_CLOCK{0..7}_SEL0
            GtmClusterFixedClockSetting: GtmClusterFixedClockSrc=CMU_FIXED_CLOCK0_SEL0
          GtmClusterConf_6
            GtmClusterConfClockSetting:
              GtmClusterConfClock{0..7}Src = CMU_CONF_CLOCK{0..7}_SEL0
            GtmClusterFixedClockSetting: GtmClusterFixedClockSrc=CMU_FIXED_CLOCK0_SEL0
          GtmClusterConf_7
            GtmClusterConfClockSetting:
              GtmClusterConfClock{0..7}Src = CMU_CONF_CLOCK{0..7}_SEL0
            GtmClusterFixedClockSetting: GtmClusterFixedClockSrc=CMU_FIXED_CLOCK0_SEL0
          GtmClusterConf_8
            GtmClusterConfClockSetting:
              GtmClusterConfClock{0..7}Src = CMU_CONF_CLOCK{0..7}_SEL0
            GtmClusterFixedClockSetting: GtmClusterFixedClockSrc=CMU_FIXED_CLOCK0_SEL0
        4 x GtmTbuChannelConf, all with GtmTbuChClockSourceSelection=CMU_CLOCK0_SEL0, GtmTbuChMode=FREE_RUNNING_COUNTER_SEL0, GtmTbuChModuloCntrSel=TBU_CH1_SEL0, GtmTbuChResolutionSel=TBU_CH_LOWER_COUNT_BITS_SEL0, GtmTbuChannelEnable=false:
          GtmTbuChannelConf_{0..3}
        7 x GtmTimGlobalConf:
          GtmTimGlobalConf_0
            8 x GtmTimChannelConf, all with GtmTimInpPortPinSel=SEL0_NONE:
              GtmTimChannelConf_{0..7}
          GtmTimGlobalConf_1
            8 x GtmTimChannelConf, all with GtmTimInpPortPinSel=SEL0_NONE:
              GtmTimChannelConf_{0..7}
          GtmTimGlobalConf_2
            8 x GtmTimChannelConf:
              GtmTimChannelConf_0: GtmTimInpPortPinSel=SEL0_NONE
              GtmTimChannelConf_1: GtmTimInpPortPinSel=SEL0_NONE
              GtmTimChannelConf_2: GtmTimInpPortPinSel=SEL3_PORT14_PIN8
              GtmTimChannelConf_{3..7}: GtmTimInpPortPinSel=SEL0_NONE
          GtmTimGlobalConf_3
            8 x GtmTimChannelConf, all with GtmTimInpPortPinSel=SEL0_NONE:
              GtmTimChannelConf_{0..7}
          GtmTimGlobalConf_4
            8 x GtmTimChannelConf, all with GtmTimInpPortPinSel=SEL0_NONE:
              GtmTimChannelConf_{0..7}
          GtmTimGlobalConf_5
            8 x GtmTimChannelConf, all with GtmTimInpPortPinSel=SEL0_NONE:
              GtmTimChannelConf_{0..7}
          GtmTimGlobalConf_6
            8 x GtmTimChannelConf, all with GtmTimInpPortPinSel=SEL0_NONE:
              GtmTimChannelConf_{0..7}
        5 x GtmTomGlobalConf:
          GtmTomGlobalConf_0
            16 x GtmTomChannelConf, all with GtmTomChInternalTriggerEnable=false, GtmTomChResetCn0OnTriggerEnable=false:
              GtmTomChannelConf_0: GtmTimerPortPinSelect=NONE
              GtmTomChannelConf_1: GtmTimerPortPinSelect=NONE
              GtmTomChannelConf_{10..15}: GtmTimerPortPinSelect=NONE
              GtmTomChannelConf_{2..7}: GtmTimerPortPinSelect=NONE
              GtmTomChannelConf_8: GtmTimerPortPinSelect=TOUT48_SELA_0_PORT22_PIN1
              GtmTomChannelConf_9: GtmTimerPortPinSelect=TOUT47_SELA_0_PORT22_PIN0
            GtmTomGroupConf_0 (GtmTomGroupConf)
              GtmTomActionTimeBaseUnitConf: GtmTomActionTimeBaseSelection=TOM_ACT_TB_TBU_TS0, GtmTomActionTimeBaseValue=1
            GtmTomGroupConf_1 (GtmTomGroupConf)
              GtmTomActionTimeBaseUnitConf: GtmTomActionTimeBaseSelection=TOM_ACT_TB_TBU_TS0, GtmTomActionTimeBaseValue=1
          GtmTomGlobalConf_1
            16 x GtmTomChannelConf, all with GtmTimerPortPinSelect=NONE, GtmTomChInternalTriggerEnable=false, GtmTomChResetCn0OnTriggerEnable=false:
              GtmTomChannelConf_0
              GtmTomChannelConf_1
              GtmTomChannelConf_{10..15}
              GtmTomChannelConf_{2..9}
            GtmTomGroupConf_0 (GtmTomGroupConf)
              GtmTomActionTimeBaseUnitConf: GtmTomActionTimeBaseSelection=TOM_ACT_TB_TBU_TS0, GtmTomActionTimeBaseValue=1
            GtmTomGroupConf_1 (GtmTomGroupConf)
              GtmTomActionTimeBaseUnitConf: GtmTomActionTimeBaseSelection=TOM_ACT_TB_TBU_TS0, GtmTomActionTimeBaseValue=1
          GtmTomGlobalConf_2
            16 x GtmTomChannelConf, all with GtmTimerPortPinSelect=NONE, GtmTomChInternalTriggerEnable=false, GtmTomChResetCn0OnTriggerEnable=false:
              GtmTomChannelConf_0
              GtmTomChannelConf_1
              GtmTomChannelConf_{10..15}
              GtmTomChannelConf_{2..9}
            GtmTomGroupConf_0 (GtmTomGroupConf)
              GtmTomActionTimeBaseUnitConf: GtmTomActionTimeBaseSelection=TOM_ACT_TB_TBU_TS0, GtmTomActionTimeBaseValue=1
            GtmTomGroupConf_1 (GtmTomGroupConf)
              GtmTomActionTimeBaseUnitConf: GtmTomActionTimeBaseSelection=TOM_ACT_TB_TBU_TS0, GtmTomActionTimeBaseValue=1
          GtmTomGlobalConf_3
            16 x GtmTomChannelConf, all with GtmTimerPortPinSelect=NONE, GtmTomChInternalTriggerEnable=false, GtmTomChResetCn0OnTriggerEnable=false:
              GtmTomChannelConf_0
              GtmTomChannelConf_1
              GtmTomChannelConf_{10..15}
              GtmTomChannelConf_{2..9}
            GtmTomGroupConf_0 (GtmTomGroupConf)
              GtmTomActionTimeBaseUnitConf: GtmTomActionTimeBaseSelection=TOM_ACT_TB_TBU_TS0, GtmTomActionTimeBaseValue=1
            GtmTomGroupConf_1 (GtmTomGroupConf)
              GtmTomActionTimeBaseUnitConf: GtmTomActionTimeBaseSelection=TOM_ACT_TB_TBU_TS0, GtmTomActionTimeBaseValue=1
          GtmTomGlobalConf_4
            16 x GtmTomChannelConf, all with GtmTimerPortPinSelect=NONE, GtmTomChInternalTriggerEnable=false, GtmTomChResetCn0OnTriggerEnable=false:
              GtmTomChannelConf_0
              GtmTomChannelConf_1
              GtmTomChannelConf_{10..15}
              GtmTomChannelConf_{2..9}
            GtmTomGroupConf_0 (GtmTomGroupConf)
              GtmTomActionTimeBaseUnitConf: GtmTomActionTimeBaseSelection=TOM_ACT_TB_TBU_TS0, GtmTomActionTimeBaseValue=1
            GtmTomGroupConf_1 (GtmTomGroupConf)
              GtmTomActionTimeBaseUnitConf: GtmTomActionTimeBaseSelection=TOM_ACT_TB_TBU_TS0, GtmTomActionTimeBaseValue=1
        12 x GtmTriggerForAdc, all with GtmAdcTrigger2Select=TRIG_0_NO_TRIGGER, GtmAdcTrigger3Select=TRIG_0_NO_TRIGGER, GtmAdcTrigger4Select=TRIG_0_NO_TRIGGER:
          GtmTriggerForAdc_0: GtmAdcTrigger0Select=TRIG_0_NO_TRIGGER, GtmAdcTrigger1Select=TRIG_0_NO_TRIGGER
          GtmTriggerForAdc_1: GtmAdcTrigger0Select=TRIG_1, GtmAdcTrigger1Select=TRIG_9
          GtmTriggerForAdc_10: GtmAdcTrigger0Select=TRIG_0_NO_TRIGGER, GtmAdcTrigger1Select=TRIG_0_NO_TRIGGER
          GtmTriggerForAdc_11: GtmAdcTrigger0Select=TRIG_0_NO_TRIGGER, GtmAdcTrigger1Select=TRIG_0_NO_TRIGGER
          GtmTriggerForAdc_{2..9}: GtmAdcTrigger0Select=TRIG_0_NO_TRIGGER, GtmAdcTrigger1Select=TRIG_0_NO_TRIGGER
        6 x GtmTriggerForDsadc, all with GtmDsadcTrigger0Select=TRIG_0_NO_TRIGGER, GtmDsadcTrigger1Select=TRIG_0_NO_TRIGGER, GtmDsadcTrigger2Select=TRIG_0_NO_TRIGGER, GtmDsadcTrigger3Select=TRIG_0_NO_TRIGGER:
          GtmTriggerForDsadc_{0..5}
        McuGtmClockManagementConf: GtmCmuGlobalClockDenominator=1, GtmCmuGlobalClockNumerator=1
          GtmConfigClockSetting:
            GtmCmuConfigClock0Div = 199
            GtmCmuConfigClock0Enable = true
            GtmCmuConfigClock1Div = 0
            GtmCmuConfigClock1Enable = true
            GtmCmuConfigClock2Div = 0
            GtmCmuConfigClock2Enable = true
            GtmCmuConfigClock3Div = 0
            GtmCmuConfigClock3Enable = true
            GtmCmuConfigClock4Div = 0
            GtmCmuConfigClock4Enable = true
            GtmCmuConfigClock5Div = 0
            GtmCmuConfigClock5Enable = true
            GtmCmuConfigClock6Div = 0
            GtmCmuConfigClock6Enable = true
            GtmCmuConfigClock7Div = 0
            GtmCmuConfigClock7Enable = true
          GtmExtClockSetting:
            GtmCmuExtClock0Denominator = 1
            GtmCmuExtClock0Enable = false
            GtmCmuExtClock0Numerator = 1
            GtmCmuExtClock1Denominator = 1
            GtmCmuExtClock1Enable = false
            GtmCmuExtClock1Numerator = 1
            GtmCmuExtClock2Denominator = 1
            GtmCmuExtClock2Enable = false
            GtmCmuExtClock2Numerator = 1
          GtmFixedClockSetting: GtmCmuFixedClockEnable=true, GtmCmuFixedClockSel=CMU_GLOBAL_CLOCK_SEL0
        3 x GtmClusterConf, all with GtmCmuClusterInputClockDividerEnable=CLS_CLK_CFG_ENABLED_WITH_DIV_SEL2:
          GtmClusterConf
            GtmClusterConfClockSetting:
              GtmClusterConfClock{0..7}Src = CMU_CONF_CLOCK{0..7}_SEL0
            GtmClusterFixedClockSetting: GtmClusterFixedClockSrc=CMU_FIXED_CLOCK0_SEL0
          GtmClusterConf_9
            GtmClusterConfClockSetting:
              GtmClusterConfClock{0..7}Src = CMU_CONF_CLOCK{0..7}_SEL0
            GtmClusterFixedClockSetting: GtmClusterFixedClockSrc=CMU_FIXED_CLOCK0_SEL0
          GtmClusterConf_10
            GtmClusterConfClockSetting:
              GtmClusterConfClock{0..7}Src = CMU_CONF_CLOCK{0..7}_SEL0
            GtmClusterFixedClockSetting: GtmClusterFixedClockSrc=CMU_FIXED_CLOCK0_SEL0
        GtmTomGlobalConf
          GtmTomGroupConf
            GtmTomActionTimeBaseUnitConf: GtmTomActionTimeBaseSelection=TOM_ACT_TB_TBU_TS0, GtmTomActionTimeBaseValue=1
          GtmTomGroupConf_1 (GtmTomGroupConf)
            GtmTomActionTimeBaseUnitConf: GtmTomActionTimeBaseSelection=TOM_ACT_TB_TBU_TS0, GtmTomActionTimeBaseValue=1
          16 x GtmTomChannelConf, all with GtmTomChResetCn0OnTriggerEnable=false, GtmTomChInternalTriggerEnable=false:
            GtmTomChannelConf
            GtmTomChannelConf_{1..15}
        3 x GtmAtomGlobalConf:
          GtmAtomGlobalConf
            GtmAtomGroupConf
              GtmAtomActionTimeBaseUnitConf: GtmAtomActionTimeBaseSelection=ATOM_ACT_TB_TBU_TS0, GtmAtomActionTimeBaseValue=1
            8 x GtmAtomChannelConf, all with GtmAtomChResetCn0OnTriggerEnable=false, GtmAtomChInternalTriggerEnable=false:
              GtmAtomChannelConf
              GtmAtomChannelConf_{1..7}
          GtmAtomGlobalConf_9
            GtmAtomGroupConf
              GtmAtomActionTimeBaseUnitConf: GtmAtomActionTimeBaseSelection=ATOM_ACT_TB_TBU_TS0, GtmAtomActionTimeBaseValue=1
            8 x GtmAtomChannelConf, all with GtmAtomChResetCn0OnTriggerEnable=false, GtmAtomChInternalTriggerEnable=false:
              GtmAtomChannelConf
              GtmAtomChannelConf_{1..7}
          GtmAtomGlobalConf_10
            GtmAtomGroupConf
              GtmAtomActionTimeBaseUnitConf: GtmAtomActionTimeBaseSelection=ATOM_ACT_TB_TBU_TS0, GtmAtomActionTimeBaseValue=1
            8 x GtmAtomChannelConf, all with GtmAtomChResetCn0OnTriggerEnable=false, GtmAtomChInternalTriggerEnable=false:
              GtmAtomChannelConf
              GtmAtomChannelConf_{1..7}
      McuClockSettingConfig_0 (McuClockSettingConfig): McuClockSettingId=0
        3 x McuClockReferencePoint:
          McuClockReferencePoint_0: McuClockRefSelection=MCU_USER_DEFINED_FREQUENCY, McuClockReferencePointFrequency=0
          McuClockReferencePoint_1: McuClockRefSelection=MCU_MCAN_FREQUENCY, McuClockReferencePointFrequency=0
          McuClockReferencePoint_2: McuClockRefSelection=MCU_QSPI_FREQUENCY, McuClockReferencePointFrequency=10000000
        McuClockReferencePointConfig
          McuClockMonitorConfig:
            McuBackupClockMonEnable = false
            McuBackupClockRangeMonEnable = false
            McuPll{0..2}ClockMonEnable = false
            McuSpbClockMonEnable = false
          McuExternalClockOutputConfig:
            McuExtClock0Enable = false
            McuExtClock1Enable = false
            McuExtClock1Inverted = false
            McuExtClockOutSel0 = FOUT_EXT_CLOCK0_SEL0
            McuExtClockOutSel1 = FOUT_EXT_CLOCK1_SEL0
            McuFoutClockDiv = 1
            McuExtClock1Div = 1
          McuPeripheralPllSettingConfig:
            McuClockReferencePointFrequency1 = 160000000
            McuClockReferencePointFrequency2 = 200000000
            McuFreqSource1ClockDivSelect = DIV_FACTOR_2_NOT_BYPASSED_SEL0
            McuPerPllK2DivStepDownChangeDelay = 10
            McuPerPllK2DivStepUpChangeDelay = 10
            McuPerPllK3DivStepDownChangeDelay = 10
            McuPerPllK3DivStepUpChangeDelay = 10
            McuPeripheralPllK2Divider = 1
            McuPeripheralPllK3Divider = 1
            McuPeripheralPllNDivider = 31
            McuPeripheralPllPDivider = 0
            McuPll2DivSelect = MCU_K3_DIV_FACTOR_NOT_BYPASSED_SEL0
          McuPllDistributionSettingConfig:
            McuAdasFrequency = 0
            McuAdcFrequency = 160000000
            McuAscLinFastFrequency = 200000000
            McuAscLinSlowClockSourceSelection = ASCLINS_CLOCK_SOURCE_DISABLED_SEL0
            McuAscLinSlowFrequency = 80000000
            McuBBBFrequency = 150000000
            McuCPU{0..3}Frequency = 300000000
            McuCPU4Frequency = 0
            McuCPU5Frequency = 0
            McuClockDistributionInpClockSel = PLL_INPUT_CLOCK_SRC_SELECT_SEL1
            McuConvCtrlPhaseSynchConf = PHASE_SYNCH_CONST_ACTIVE_SEL0
            McuEbuClkEnable = false
            McuEbuFrequency = 0
            McuErayClkEnable = false
            McuErayFrequency = 80000000
            McuFSI2Frequency = 300000000
            McuFSIFrequency = 100000000
            McuGEthFrequency = 150000000
            McuGTMFrequency = 200000000
            McuHsctFrequency = 320000000
            McuHspdm160Frequency = 0
            McuHspdm320Frequency = 0
            McuHspdmClkEnable = false
            McuI2CFrequency = 66666667
            McuLowPowerDivValue = LOW_POWER_DIVIDER_DISABLE_SEL0
            McuMCanClockSourceSelection = MCAN_CLOCK_SOURCE_MCANI_SEL1
            McuMCanFrequency = 80000000
            McuMcanHFrequency = 100000000
            McuMscClockSourceSelection = MSC_CLOCK_SOURCE_DISABLED_SEL0
            McuMscFrequency = 200000000
            McuQspiClockSourceSelection = QSPI_CLOCK_SOURCE_SOURCE2_SEL2
            McuQspiFrequency = 20000000
            McuReferenceFrequency1 = 12500000
            McuReferenceFrequency2 = 6666667
            McuSPBFrequency = 100000000
            McuSRIFrequency = 300000000
            McuSTMFrequency = 100000000
          McuSystemPllSettingConfig:
            McuClockReferencePointFrequency0 = 300000000
            McuFMPllModAmp = 1.25
            McuFmPllEnable = false
            McuPllInputSrcSelection = OSC_CLOCK_SRC_SELECT_SEL1
            McuSysPllK2DivStepDownChangeDelay = 10
            McuSysPllK2DivStepUpChangeDelay = 10
            McuSystemPllK2Divider = 1
            McuSystemPllNDivider = 29
            McuSystemPllPDivider = 0
      McuEruGlobalConf: McuEruInputFilterRegVal=0
      McuGpt12PrescalerConf: Gpt1BlockPrescalerSel=GPT1_PRESCALING_FACTOR_4, Gpt2BlockPrescalerSel=GPT2_BLOCK_NOT_USED
      McuModeSettingConf_0 (McuModeSettingConf): McuEvrcLPMOnSleepReqEnable=false, McuMode=0
        McuStdbyModeSettingConf:
          McuStdbyModeBlankingFilterDelay = DELAY_0_MS_SEL0
          McuStdbyModeClkSelection = SCR_CLOCK_SEL0
          McuStdbyModeESR0TriStateEnable = false
          McuStdbyModePORSTFilterEnable = false
          McuStdbyModePortTriStateEnable = false
          McuStdbyModeRamEnable = MCU_STANDBYRAM_DISABLED_SEL0
          McuStdbyModeWakeupFromEVR = false
          McuStdbyModeWakeupFromPORST = false
          McuStdbyModeWakeupFromSCR = false
          McuStdbyModeESR0Conf: McuStdbyModeESR0EdgeDetection=ESR0_TRIG_RISING_EDGE_SEL1, McuStdbyModeESR0FltEnable=false, McuStdbyModeESR0WakeupEnable=false
          McuStdbyModeESR1Conf: McuStdbyModeESR1EdgeDetection=ESR1_TRIG_RISING_EDGE_SEL1, McuStdbyModeESR1FltEnable=false, McuStdbyModeESR1WakeupEnable=false
          McuStdbyModePinAConf: McuStdbyModePinAEdgeDetection=PINA_TRIG_RISING_EDGE_SEL1, McuStdbyModePinAFltEnable=false, McuStdbyModePinAWakeupEnable=false
          McuStdbyModePinBConf: McuStdbyModePinBEdgeDetection=PINB_TRIG_RISING_EDGE_SEL1, McuStdbyModePinBFltEnable=false, McuStdbyModePinBWakeupEnable=false
          McuStdbyModeVddVextConf:
            McuStdbyModeEntryOnVDDRampDown = false
            McuStdbyModeEntryOnVEXTRampDown = false
            McuStdbyModeVddUMMonMode = VDD_UV_MON_MODE_SEL2
            McuStdbyModeVddUVThres = 184
            McuStdbyModeVextUMMonMode = VEXT_UV_MON_MODE_SEL2
            McuStdbyModeVextUVThres = 117
          McuStdbyModeWakeupTimerConf:
            McuStdbyModeWakeupTimerClkDiv = WUT_70KHZ_NO_DIV_CLK_SEL0
            McuStdbyModeWakeupTimerEnable = false
            McuStdbyModeWakeupTimerMode = WUT_AUTO_RELOAD_MODE_SEL0
            McuStdbyModeWakeupTimerValue = 16777215
      McuResetSettingConf:
        McuESR0ResetConf = MCU_ESR0_NO_RESET_SEL0
        McuESR1ResetConf = MCU_ESR1_NO_RESET_SEL0
        McuSMUResetConf = MCU_SMU_NO_RESET_SEL0
        McuSTM0ResetConf = MCU_STM0_NO_RESET_SEL0
        McuSTM0ResetOnApplResetEnable = true
        McuSTM1ResetConf = MCU_STM1_NO_RESET_SEL0
        McuSTM1ResetOnApplResetEnable = true
        McuSTM2ResetConf = MCU_STM2_NO_RESET_SEL0
        McuSTM2ResetOnApplResetEnable = true
        McuSTM3ResetConf = MCU_STM3_NO_RESET_SEL0
        McuSTM3ResetOnApplResetEnable = true
        McuSTM4ResetConf = MCU_STM4_NO_RESET_SEL0
        McuSTM4ResetOnApplResetEnable = true
        McuSTM5ResetConf = MCU_STM5_NO_RESET_SEL0
        McuSTM5ResetOnApplResetEnable = true
        McuSWResetConf = MCU_SW_NO_RESET_SEL0
      McuTrapSettingConf:
        McuCPU0ESR0TrapEnable = false
        McuCPU0ESR1TrapEnable = false
        McuCPU0SMUTrapEnable = false
        McuCPU0Trap2Enable = false
        McuCPU1ESR0TrapEnable = false
        McuCPU1ESR1TrapEnable = false
        McuCPU1SMUTrapEnable = false
        McuCPU1Trap2Enable = false
        McuCPU2ESR0TrapEnable = false
        McuCPU2ESR1TrapEnable = false
        McuCPU2SMUTrapEnable = false
        McuCPU2Trap2Enable = false
        McuCPU3ESR0TrapEnable = false
        McuCPU3ESR1TrapEnable = false
        McuCPU3SMUTrapEnable = false
        McuCPU3Trap2Enable = false
        McuCPU4ESR0TrapEnable = false
        McuCPU4ESR1TrapEnable = false
        McuCPU4SMUTrapEnable = false
        McuCPU4Trap2Enable = false
        McuCPU5ESR0TrapEnable = false
        McuCPU5ESR1TrapEnable = false
        McuCPU5SMUTrapEnable = false
        McuCPU5Trap2Enable = false
    McuPublishedInformation
      21 x McuResetReasonConf:
        MCU_CB0_RESET: McuResetReason=11
        MCU_CB1_RESET: McuResetReason=12
        MCU_CB3_RESET: McuResetReason=13
        MCU_ESR0_RESET: McuResetReason=0
        MCU_ESR1_RESET: McuResetReason=1
        MCU_EVR33_RESET: McuResetReason=15
        MCU_EVRC_RESET: McuResetReason=14
        MCU_LBIST_RESET: McuResetReason=18
        MCU_POWER_ON_RESET: McuResetReason=10
        MCU_RESET_MULTIPLE: McuResetReason=254
        MCU_RESET_UNDEFINED: McuResetReason=255
        MCU_SMU_RESET: McuResetReason=2
        MCU_STBYR_RESET: McuResetReason=17
        MCU_STM0_RESET: McuResetReason=4
        MCU_STM1_RESET: McuResetReason=5
        MCU_STM2_RESET: McuResetReason=6
        MCU_STM3_RESET: McuResetReason=7
        MCU_STM4_RESET: McuResetReason=8
        MCU_STM5_RESET: McuResetReason=9
        MCU_SUPPLY_WDOG_RESET: McuResetReason=16
        MCU_SW_RESET: McuResetReason=3
