AUTOSAR XML (schema 00046)
package /ActiveEcuC
  module config Rte: implementation-config-variant=VARIANT-PRE-COMPILE, module-description=Rte_Impl
    RteOsInteraction
      Rte_Al_TE2_OsTask_10ms_OsCore0_0_10ms (RteUsedOsActivation):
        RteExpectedActivationOffset = 0
        RteExpectedTickDuration = 0
        RteActivationOsAlarmRef = Rte_Al_TE2_OsTask_10ms_OsCore0_0_10ms
        RteActivationOsTaskRef = OsTask_10ms__OsCore0
    RteGeneration:
      RteGenerationMode = COMPATIBILITY_MODE
      RteIocInteractionReturnValue = RTE_IOC
      RteValueRangeCheckEnabled = false
      RteCalibrationSupport = NONE
      RteCodeVendorId = 30
      RteDevErrorDetect = false
      RteDevErrorDetectUninit = false
      RteMeasurementSupport = false
      RteOptimizationMode = MEMORY
      RteVfbTraceEnabled = false
    RteInitializationBehavior: RteInitializationStrategy=RTE_INITIALIZATION_STRATEGY_AT_DATA_DECLARATION, RteSectionInitializationPolicy=INIT
    RteBswGeneral: RteSchMVersionInfoApi=false, RteUseComShadowSignalApi=false
    Os_OsCore0_swc_EcuSwComposition (RteSwComponentInstance): RteSoftwareComponentInstanceRef=Os_OsCore0_swc
      OpEventGetCounterValue_GetCounterValue_OsService_SystemTimer (RteEventToTaskMapping): RteImmediateRestart=false, RteEventRef=OpEventGetCounterValue_GetCounterValue_OsService_SystemTimer
      OpEventGetElapsedValue_GetElapsedValue_OsService_SystemTimer (RteEventToTaskMapping): RteImmediateRestart=false, RteEventRef=OpEventGetElapsedValue_GetElapsedValue_OsService_SystemTimer
    EcuM_EcuSwComposition (RteSwComponentInstance): RteSoftwareComponentInstanceRef=EcuM
      8 x RteEventToTaskMapping, all with RteImmediateRestart=false:
        Timer_EcuM_MainFunction: RtePositionInTask=0, RteEventRef=Timer_EcuM_MainFunction, RteMappedToTaskRef=OsTask_10ms__OsCore0, RteUsedOsAlarmRef=(unset)
        OpEventSelectShutdownTarget_SelectShutdownTarget_EcuM_ShutdownTarget: RteEventRef=OpEventSelectShutdownTarget_SelectShutdownTarget_EcuM_ShutdownTarget
        OpEventGetShutdownTarget_GetShutdownTarget_EcuM_ShutdownTarget: RteEventRef=OpEventGetShutdownTarget_GetShutdownTarget_EcuM_ShutdownTarget
        OpEventGetLastShutdownTarget_GetLastShutdownTarget_EcuM_ShutdownTarget: RteEventRef=OpEventGetLastShutdownTarget_GetLastShutdownTarget_EcuM_ShutdownTarget
        OpEventSelectShutdownCause_SelectShutdownCause_EcuM_ShutdownTarget: RteEventRef=OpEventSelectShutdownCause_SelectShutdownCause_EcuM_ShutdownTarget
        OpEventGetShutdownCause_GetShutdownCause_EcuM_ShutdownTarget: RteEventRef=OpEventGetShutdownCause_GetShutdownCause_EcuM_ShutdownTarget
        OpEventSelectBootTarget_SelectBootTarget_EcuM_BootTarget: RteEventRef=OpEventSelectBootTarget_SelectBootTarget_EcuM_BootTarget
        OpEventGetBootTarget_GetBootTarget_EcuM_BootTarget: RteEventRef=OpEventGetBootTarget_GetBootTarget_EcuM_BootTarget
    4 x RteBswModuleInstance:
      EcuM: RteBswImplementationRef=EcuM_Impl, RteBswModuleConfigurationRef=EcuM
        EcuM_MainFunctionTimingEvent0 (RteBswEventToTaskMapping):
          RteBswImmediateRestart = false
          RteBswPositionInTask = 0
          RteBswEventRef = EcuM_MainFunctionTimingEvent0
          RteBswMappedToTaskRef = OsTask_10ms__OsCore0
          RteBswUsedOsAlarmRef = Rte_Al_TE2_OsTask_10ms_OsCore0_0_10ms
        3 x RteBswExclusiveAreaImpl, all with RteExclusiveAreaImplMechanism=ALL_INTERRUPT_BLOCKING:
          ECUM_EXCLUSIVE_AREA_{0..2}: RteBswExclusiveAreaRef=ECUM_EXCLUSIVE_AREA_{0..2}
      Mcu: RteBswImplementationRef=Mcu_Impl, RteBswModuleConfigurationRef=Mcu
        TomTgcReg (RteBswExclusiveAreaImpl): RteExclusiveAreaImplMechanism=ALL_INTERRUPT_BLOCKING, RteBswExclusiveAreaRef=TomTgcReg
        AtomAgcReg (RteBswExclusiveAreaImpl): RteExclusiveAreaImplMechanism=ALL_INTERRUPT_BLOCKING, RteBswExclusiveAreaRef=AtomAgcReg
      Rte: RteBswImplementationRef=Rte_Impl, RteBswModuleConfigurationRef=Rte
      Det: RteBswImplementationRef=Det_Impl, RteBswModuleConfigurationRef=Det
        DET_EXCLUSIVE_AREA_0 (RteBswExclusiveAreaImpl): RteExclusiveAreaImplMechanism=ALL_INTERRUPT_BLOCKING, RteBswExclusiveAreaRef=DET_EXCLUSIVE_AREA_0
    Det_EcuSwComposition (RteSwComponentInstance): RteSoftwareComponentInstanceRef=Det
    BswM (RteBswModuleInstance): RteBswImplementationRef=BswM_Impl, RteBswModuleConfigurationRef=BswM
      BswM_MainFunctionTimingEvent0 (RteBswEventToTaskMapping):
        RteBswImmediateRestart = false
        RteBswPositionInTask = 1
        RteBswEventRef = BswM_MainFunctionTimingEvent0
        RteBswMappedToTaskRef = OsTask_10ms__OsCore0
        RteBswUsedOsAlarmRef = Rte_Al_TE2_OsTask_10ms_OsCore0_0_10ms
      BSWM_EXCLUSIVE_AREA_0 (RteBswExclusiveAreaImpl): RteExclusiveAreaImplMechanism=ALL_INTERRUPT_BLOCKING, RteBswExclusiveAreaRef=BSWM_EXCLUSIVE_AREA_0
    BswM_EcuSwComposition (RteSwComponentInstance): RteSoftwareComponentInstanceRef=BswM
      Timer_BswM_MainFunction (RteEventToTaskMapping):
        RteImmediateRestart = false
        RtePositionInTask = 1
        RteEventRef = Timer_BswM_MainFunction
        RteMappedToTaskRef = OsTask_10ms__OsCore0
        RteUsedOsAlarmRef = Rte_Al_TE2_OsTask_10ms_OsCore0_0_10ms
