AUTOSAR XML (schema 00046)
package /ActiveEcuC
  module config vSet: implementation-config-variant=VARIANT-PRE-COMPILE, module-description=vSet_Impl
    vSetGeneral: vSetDummyStatementKind=None
    vSetPlatform:
      vSetByteOrder = LITTLE_ENDIAN
      vSetCPUType = CPU32Bit
      vSetSizeOfEnum = Size32Bit
      vSetSizeOfRAMPointer = Size32Bit
      vSetSizeOfInt = Size32Bit
      vSetSizeOfROMPointer = Size32Bit
      vSetBitOrder = LSB_to_MSB
    vSetCalibration
