AUTOSAR XML (schema 00046)
package /ActiveEcuC
  ecuc value collection ActiveEcuC: ecu-extract=SYSTEM, ecuc-values=[Os, EcuC, EcuM, vSet, Mcu, Rte, Det, BswM]
