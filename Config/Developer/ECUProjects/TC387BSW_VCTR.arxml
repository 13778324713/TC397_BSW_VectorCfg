AUTOSAR XML (schema 00046)
package /ECUCompositionTypes
  composition sw component type ECU_Composition
package /EndToEndProtections
  end to end protection set EndToEndProtectionSet
package /Systems
  system TC387BSW_VCTR
    root-software-compositions:
      root sw composition prototype EcuSwComposition: software-composition=ECU_Composition
