AUTOSAR XML (schema 4-0-3)
package /DaVinci_Project
  module config Rte
    4 x RteBswModuleInstance:
      BswM
        BswM_MainFunctionTimingEvent0 (RteBswEventToTaskMapping): RteBswUsedOsAlarmRef=Os/Rte_Al_TE2_OsTask_10ms_OsCore0_0_10ms
      Det
      EcuM
        EcuM_MainFunctionTimingEvent0 (RteBswEventToTaskMapping): RteBswUsedOsAlarmRef=Os/Rte_Al_TE2_OsTask_10ms_OsCore0_0_10ms
      Mcu
    4 x RteSwComponentInstance:
      BswM_EcuSwComposition
        Timer_BswM_MainFunction (RteEventToTaskMapping): RteUsedOsAlarmRef=Os/Rte_Al_TE2_OsTask_10ms_OsCore0_0_10ms
      Det_EcuSwComposition
      EcuM_EcuSwComposition
        Timer_EcuM_MainFunction (RteEventToTaskMapping): RteUsedOsAlarmRef=Os/Rte_Al_TE2_OsTask_10ms_OsCore0_0_10ms
      Os_OsCore0_swc_EcuSwComposition
    RteOsInteraction
      Rte_Al_TE2_OsTask_10ms_OsCore0_0_10ms (RteUsedOsActivation): RteExpectedActivationOffset=0, RteActivationOsAlarmRef=Os/Rte_Al_TE2_OsTask_10ms_OsCore0_0_10ms, RteActivationOsTaskRef=OsTask_10ms__OsCore0
  module config NvM
  module config Os
    OsTask_10ms__OsCore0 (OsTask): OsTaskActivation=1, OsTaskPriority=15, OsTaskSchedule=FULL
    Rte_Al_TE2_OsTask_10ms_OsCore0_0_10ms (OsAlarm): OsAlarmCounterRef=SystemTimer
      OsAlarmAction
        OsAlarmActivateTask: OsAlarmActivateTaskRef=OsTask_10ms__OsCore0
  module config EcuC
  ecuc value collection DaVinci_Project: ecuc-values=[Com, Rte, Os, EcuC, NvM]
